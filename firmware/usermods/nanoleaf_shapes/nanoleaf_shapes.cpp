#ifdef ARDUINO_ARCH_ESP32
// AI disclaimer from Cptmeme's original usermod:
// AI: below section was generated by an AI
/*
 * Nanoleaf Shapes panels as a WLED usermod.
 *
 * WLED renders into the configured LED output; this usermod copies the first
 * N pixels out of the rendered frame in handleOverlayDraw() and a background task pushes them to
 * the panels. The bus is never touched from the WLED loop, so a slow panel chain cannot stall
 * effects.
 *
 * Protocol reference: https://github.com/MyrikLD/LeafBus/blob/main/PROTOCOL.md
 *  - bulk pull (C0) replies come in layout-string order (first pair = nearest panel), while bulk
 *    push (E0) chunks are reversed (first chunk = farthest panel)
 *  - the panel hosting the power supply ORs 0x20 into its status byte
 *
 * C3 hardware: GPIO4 TX and GPIO5 RX share DATA, pulled to 3.3 V through 10 kohm.
 * TX is open-drain and explicitly disabled after transmission. No external buffers.
 * The local echo is checked and stripped before reading a panel reply.
 */
#include "wled.h"
#include "driver/uart.h"
#include "driver/gpio.h"
#include "esp_rom_gpio.h"
#include "soc/gpio_sig_map.h"
#include "soc/gpio_reg.h"
#include "soc/gpio_struct.h"
#include "hal/gpio_ll.h"
#include <atomic>
#include "leafbus_geometry.h"

static constexpr uint8_t  LB_ROOT_DETECT    = 0x00;   // panels note the connector facing the master
static constexpr uint8_t  LB_LAYOUT_DETECT  = 0x80;   // reply: layout string ending in LB_TERMINATOR
static constexpr uint8_t  LB_BULK_PULL      = 0xC0;   // reply: 2 status bytes per panel
static constexpr uint8_t  LB_BULK_PUSH      = 0xE0;   // colour for every panel, no reply
static constexpr uint8_t  LB_GLOBAL_CMD     = 0xFC;
static constexpr uint8_t  LB_CMD_BRIGHTNESS = 0x04;
static constexpr uint8_t  LB_TERMINATOR     = 0x40;
static constexpr uint8_t  LB_HOTPLUG        = 0xCC;   // trailing byte of a pull reply after a change
static constexpr uint8_t  LB_PSU_CODE       = 1;      // connector-count code of the power supply node
static constexpr uint8_t  LB_TRANSITION     = 1;      // chunk fade time, as LeafBus uses for streaming
static constexpr uint32_t LB_BAUD           = 1000000;
static constexpr uint32_t LB_POLL_MS        = 50;     // stock cadence; unpolled panels apply only the first frame
static constexpr uint32_t LB_MIN_FRAME_MS   = 25;     // at most 40 colour frames per second
static constexpr uint32_t LB_RETRY_MS       = 5000;   // enumeration retry while nothing answers
static constexpr uint32_t LB_REENUM_MS      = 2000;   // enumeration retry after a hot-plug
static constexpr uint32_t LB_ECHO_MS        = 5;
static constexpr uint32_t LB_LONG_WINDOW_MS = 1500;   // far panels can be slow to relay the layout
static constexpr uint8_t  LB_MISS_LIMIT     = 20;     // unanswered polls before re-enumerating
static constexpr uint8_t  LB_LAYOUT_TRIES   = 6;
static constexpr uint16_t LB_MAX_PANELS     = 64;
static constexpr size_t   LB_MAX_LAYOUT     = 256;
static constexpr size_t   LB_RX_BUFFER      = 4096;
static constexpr uint32_t LB_ROOT_SETTLE_MS = 100;
static constexpr int      LB_EXPECT_TERMINATOR = -1;
static constexpr char     LB_LEDMAP[]       = "/ledmap.json";
static constexpr char     LB_MAP_MARK[]     = "\"generator\":\"nanoleaf-shapes\"";   // tags maps written here

#if defined(SOC_UART_HP_NUM) && SOC_UART_HP_NUM > 2
static constexpr uart_port_t LB_UART = UART_NUM_2;
#else
static constexpr uart_port_t LB_UART = UART_NUM_1;
#endif

// Board defaults; override per build with -D LEAFBUS_TX_PIN=.. -D LEAFBUS_RX_PIN=..
// GPIO4 TX and GPIO5 RX share panel DATA on the ESP32-C3 SuperMini.
#ifndef LEAFBUS_TX_PIN
  #define LEAFBUS_TX_PIN 4
#endif
#ifndef LEAFBUS_RX_PIN
  #define LEAFBUS_RX_PIN 5
#endif

class UsermodNanoleafShapes : public Usermod {
  public:
    void setup() override {
      if (enabled) start();
      initDone = true;
    }

    // The bus lives in its own task. Restarts requested by readFromConfig() run here, in the same
    // task as handleOverlayDraw(), so the frame buffer and lock are never freed under it.
    void loop() override {
      if (!_restart) return;
      _restart = false;
      stop();
      if (enabled) start();
    }

    // Called right after the effects have rendered, before the strip is shown: the cheapest place
    // to take a consistent copy of the frame. Only memcpy-grade work happens here.
    void handleOverlayDraw() override {
      if (!running || !_frame) return;
      const unsigned total  = strip.getLengthTotal();
      const unsigned panels = std::min<unsigned>(_panels, LB_MAX_PANELS); // sampled once: the task may change it
      if (!panels) return;
      const unsigned bri = strip.getBrightness() + 1;
      // same rule as WS2812FX::show(): gamma before brightness
      const bool gamma = gammaCorrectCol && !(realtimeMode && arlsDisableGammaCorrection && !realtimeOverride);
      if (xSemaphoreTake(_lock, 0) != pdTRUE) return;        // never wait in the render path
      memset(_frame, 0, panels * 4);                         // panels without a pixel stay dark
      // The frame buffer is indexed by logical (matrix) position; the ledmap sends logical pixel
      // `cell` to panel getMappedPixelIndex(cell), gaps map past the end.
      for (unsigned cell = 0; cell < total; cell++) {
        const unsigned i = strip.getMappedPixelIndex(cell);
        if (i >= panels) continue;
        uint8_t *p = _frame + i * 4;
        uint32_t c = strip.getPixelColorNoMap(cell);
        if (c && gamma) c = gamma32(c);
        p[0] = (R(c) * bri) >> 8;
        p[1] = (G(c) * bri) >> 8;
        p[2] = (B(c) * bri) >> 8;
        p[3] = (W(c) * bri) >> 8;
      }
      _framePixels = panels;
      _dirty = true;
      xSemaphoreGive(_lock);
      if (_task) xTaskNotifyGive(_task);
    }

    void addToJsonInfo(JsonObject &root) override {
      JsonObject user = root["u"];
      if (user.isNull()) user = root.createNestedObject("u");
      JsonArray arr = user.createNestedArray(FPSTR(_name));
      if (!enabled)      arr.add(F("disabled"));
      else if (!running) arr.add(F("init failed"));
      else if (!_panels) arr.add(F("no panels"));
      else { arr.add(_panels); arr.add(F(" panels")); }
      JsonArray electrical = user.createNestedArray(F("Nanoleaf wiring"));
      electrical.add(F("GPIO4 TX / GPIO5 RX; open-drain; 10k pull-up"));
      JsonArray tx = user.createNestedArray(F("Nanoleaf TX / echo errors"));
      tx.add(_txFrames.load()); tx.add(_echoErrors.load());
      JsonArray layout = user.createNestedArray(F("Nanoleaf layout replies / requests"));
      layout.add(_layoutReplies.load()); layout.add(_layoutRequests.load());
      JsonArray polls = user.createNestedArray(F("Nanoleaf poll replies / requests"));
      polls.add(_pollReplies.load()); polls.add(_polls.load());
      JsonArray pushes = user.createNestedArray(F("Nanoleaf colour frames"));
      pushes.add(_colourFrames.load());
    }

    void addToConfig(JsonObject &root) override {
      JsonObject top = root.createNestedObject(FPSTR(_name));
      top[F("enabled")]  = enabled;
      top[F("txPin")]    = txPin;
      top[F("rxPin")]    = rxPin;
      top[F("autoMap")]  = autoMap;      // maintain /ledmap.json from the panel layout
      top[F("rotation")] = rotation;     // degrees, rotates that map
    }

    bool readFromConfig(JsonObject &root) override {
      JsonObject top = root[FPSTR(_name)];
      if (top.isNull()) return false;
      const bool    wasEnabled = enabled, oldAutoMap = autoMap;
      const int8_t  oldTx = txPin, oldRx = rxPin;
      const int16_t oldRotation = rotation;
      getJsonValue(top[F("enabled")],  enabled);
      getJsonValue(top[F("txPin")],    txPin);
      getJsonValue(top[F("rxPin")],    rxPin);
      getJsonValue(top[F("autoMap")],  autoMap);
      getJsonValue(top[F("rotation")], rotation);
      rotation = ((rotation % 360) + 360) % 360;
      // Called from the web server task: hand the restart to loop()
      if (initDone && (enabled != wasEnabled || txPin != oldTx || rxPin != oldRx)) _restart = true;
      if (autoMap != oldAutoMap || rotation != oldRotation) _mapDone = false; // the bus task rebuilds the map
      return true;
    }

    uint16_t getId() override { return USERMOD_ID_UNSPECIFIED; }

  private:
    // configuration
    bool    enabled  = true;
    int8_t  txPin    = LEAFBUS_TX_PIN;
    int8_t  rxPin    = LEAFBUS_RX_PIN;
    bool    autoMap  = true;
    int16_t rotation = 0;

    bool initDone = false;
    bool running  = false;
    volatile bool _restart = false;       // set by readFromConfig(), handled in loop()

    uint8_t *_frame = nullptr;            // brightness-scaled RGBW handed to the bus task
    volatile bool     _dirty = false;
    volatile bool     _stop  = false;
    volatile uint16_t _framePixels = 0;
    bool  _pinsAllocated = false;
    bool  _uartInstalled = false;
    TaskHandle_t      _task    = nullptr;
    SemaphoreHandle_t _lock    = nullptr; // guards _frame and _dirty
    SemaphoreHandle_t _stopped = nullptr; // given by the bus task when it exits
    // state below is only touched by the bus task
    volatile uint16_t _panels = 0;        // panels found by the last enumeration, 0 = none
    bool     _hotplug = false;
    uint8_t  _missRun = 0;
    uint32_t _lastPoll = 0, _lastPush = 0, _nextEnum = 0;
    uint8_t  _layout[LB_MAX_LAYOUT];
    size_t   _layoutLen = 0;
    volatile bool _mapDone = false;       // cleared by readFromConfig() when the map settings change
    std::atomic<uint32_t> _txFrames{0}, _echoErrors{0}, _layoutRequests{0}, _layoutReplies{0};
    std::atomic<uint32_t> _polls{0}, _pollReplies{0}, _colourFrames{0};

    static const char _name[];

    void releaseTx() {
      if (_pinsAllocated) gpio_ll_output_disable(&GPIO, txPin);
    }

    void start() {
      // Saved settings must not route this board-specific driver to other pins.
      if (running || txPin != LEAFBUS_TX_PIN || rxPin != LEAFBUS_RX_PIN) return;
      managed_pin_type pins[2] = {{txPin, true}, {rxPin, false}};
      _pinsAllocated = PinManager::allocateMultiplePins(pins, 2, PinOwner::UM_Unspecified);
      if (!_pinsAllocated) { DEBUG_PRINTLN(F("LeafBus: pins in use")); return; }
      releaseTx();
      gpio_set_direction((gpio_num_t)txPin, GPIO_MODE_INPUT);
      gpio_set_direction((gpio_num_t)rxPin, GPIO_MODE_INPUT);
      gpio_set_pull_mode((gpio_num_t)txPin, GPIO_FLOATING);
      gpio_set_pull_mode((gpio_num_t)rxPin, GPIO_FLOATING);

      _frame   = (uint8_t*)calloc(LB_MAX_PANELS, 4);
      _lock    = xSemaphoreCreateMutex();
      _stopped = xSemaphoreCreateBinary();
      if (!_frame || !_lock || !_stopped) { stop(); return; }

      uart_config_t cfg = {};
      cfg.baud_rate = LB_BAUD;
      cfg.data_bits = UART_DATA_8_BITS;
      cfg.parity    = UART_PARITY_DISABLE;
      cfg.stop_bits = UART_STOP_BITS_1;
      cfg.flow_ctrl = UART_HW_FLOWCTRL_DISABLE;
      #if ESP_IDF_VERSION_MAJOR >= 5
      cfg.source_clk = UART_SCLK_XTAL;
      #else
      cfg.source_clk = UART_SCLK_APB;
      #endif
      _stop = false;
      _uartInstalled = uart_driver_install(LB_UART, LB_RX_BUFFER, 0, 0, nullptr, 0) == ESP_OK;
      if (!_uartInstalled || uart_param_config(LB_UART, &cfg) != ESP_OK
          || uart_set_rx_full_threshold(LB_UART, 16) != ESP_OK
          || uart_set_rx_timeout(LB_UART, 2) != ESP_OK) {
        stop();
        return;
      }
      // Route UART without uart_set_pin(), which briefly enables push-pull TX.
      gpio_ll_od_enable(&GPIO, txPin);
      esp_rom_gpio_connect_out_signal(txPin, U1TXD_OUT_IDX, false, false);
      REG_SET_BIT(GPIO_FUNC0_OUT_SEL_CFG_REG + 4 * txPin, GPIO_FUNC0_OEN_SEL);
      releaseTx();
      gpio_input_enable((gpio_num_t)rxPin);
      esp_rom_gpio_connect_in_signal(rxPin, U1RXD_IN_IDX, false);
      if (xTaskCreate(taskEntry, "Nanoleaf", 8192, this, 2, &_task) != pdPASS) {
        _task = nullptr;
        stop();
        return;
      }
      running = true;
      DEBUG_PRINTF_P(PSTR("Nanoleaf C3: TX %d open-drain, RX %d, external 10k pull-up\n"), txPin, rxPin);
    }

    void stop() {
      running = false;
      if (_task) {
        _stop = true;
        xTaskNotifyGive(_task);
        // the task checks _stop between bus transactions; an enumeration step takes at most ~1.5 s
        if (xSemaphoreTake(_stopped, pdMS_TO_TICKS(3000)) != pdTRUE) vTaskDelete(_task);
        _task = nullptr;
      }
      releaseTx();
      if (_uartInstalled) { uart_driver_delete(LB_UART); _uartInstalled = false; }
      if (_pinsAllocated) {
        // Release both pins; the external resistor supplies the idle level.
        gpio_reset_pin((gpio_num_t)txPin);
        gpio_reset_pin((gpio_num_t)rxPin);
        gpio_set_direction((gpio_num_t)txPin, GPIO_MODE_INPUT);
        gpio_set_direction((gpio_num_t)rxPin, GPIO_MODE_INPUT);
        gpio_set_pull_mode((gpio_num_t)txPin, GPIO_FLOATING);
        gpio_set_pull_mode((gpio_num_t)rxPin, GPIO_FLOATING);
        uint8_t p[2] = {(uint8_t)txPin, (uint8_t)rxPin};
        PinManager::deallocateMultiplePins(p, 2, PinOwner::UM_Unspecified);
        _pinsAllocated = false;
      }
      if (_lock)    vSemaphoreDelete(_lock);
      if (_stopped) vSemaphoreDelete(_stopped);
      _lock = _stopped = nullptr;
      free(_frame);
      _frame = nullptr;
      _panels = 0;
      _layoutLen = 0;
    }

    static void taskEntry(void *arg) { static_cast<UsermodNanoleafShapes*>(arg)->run(); }

    void run() {
      while (!_stop) {
        ulTaskNotifyTake(pdTRUE, pdMS_TO_TICKS(5)); // woken by handleOverlayDraw(), else keeps the poll cadence
        if (_stop) break;
        uint32_t now = millis();
        if (_panels == 0 || _hotplug) {
          if ((int32_t)(now - _nextEnum) >= 0) {
            enumerate();
            _nextEnum = millis() + (_panels ? LB_REENUM_MS : LB_RETRY_MS);
          }
          continue;
        }
        if (!_mapDone && _layoutLen) updateLedmap();
        if (_dirty && now - _lastPush >= LB_MIN_FRAME_MS) push();
        if (now - _lastPoll >= LB_POLL_MS) poll();
      }
      xSemaphoreGive(_stopped);
      vTaskDelete(nullptr);
    }

    // Transmit a frame and consume its echo. Returns false if the echo was not our frame.
    bool send(const uint8_t *frame, size_t len) {
      uint8_t echo[32];
      size_t got = 0;
      bool ok = true;
      uart_flush_input(LB_UART);
      gpio_ll_od_enable(&GPIO, txPin);
      gpio_ll_output_enable(&GPIO, txPin);
      int written = uart_write_bytes(LB_UART, frame, len);
      esp_err_t done = uart_wait_tx_done(LB_UART, pdMS_TO_TICKS(20));
      releaseTx();
      _txFrames++;
      if (written != (int)len || done != ESP_OK) {
        _echoErrors++;
        return false;
      }
      uint32_t start = millis();
      while (got < len && millis() - start < LB_ECHO_MS + len / 100) {
        int n = uart_read_bytes(LB_UART, echo, std::min(len - got, sizeof(echo)), pdMS_TO_TICKS(1));
        if (n <= 0) continue;
        ok = ok && memcmp(echo, frame + got, n) == 0;
        got += n;
      }
      if (!ok || got != len) { _echoErrors++; return false; }
      return true;
    }

    // Read a reply until `expect` bytes, the layout terminator or the deadline.
    size_t receive(uint8_t *buf, size_t max, int expect, uint32_t waitMs) {
      size_t limit = (expect > 0 && (size_t)expect < max) ? expect : max;
      size_t n = 0;
      uint32_t start = millis();
      while (n < limit && millis() - start < waitMs && !_stop) {
        int r = uart_read_bytes(LB_UART, buf + n, limit - n, pdMS_TO_TICKS(1));
        if (r <= 0) continue;
        n += r;
        if (expect == LB_EXPECT_TERMINATOR && memchr(buf, LB_TERMINATOR, n)) break;
      }
      return n;
    }

    // Root detect, then layout detect until the same string is read twice: the head of the
    // string can arrive corrupted on big assemblies. Pixel order follows the panel nodes in it.
    void enumerate() {
      static const uint8_t rootDetect[]   = {LB_ROOT_DETECT};
      static const uint8_t layoutDetect[] = {LB_LAYOUT_DETECT};
      static const uint8_t fullBright[]   = {LB_GLOBAL_CMD, LB_CMD_BRIGHTNESS, 0xFF};
      uint8_t cur[LB_MAX_LAYOUT], last[LB_MAX_LAYOUT];
      size_t lastLen = 0;
      bool stable = false;

      for (unsigned i = 0; i < LB_LAYOUT_TRIES && !stable && !_stop; i++) {
        if (!send(rootDetect, sizeof(rootDetect))) continue;
        vTaskDelay(pdMS_TO_TICKS(LB_ROOT_SETTLE_MS));
        _layoutRequests++;
        if (!send(layoutDetect, sizeof(layoutDetect))) continue;
        size_t n = receive(cur, sizeof(cur), LB_EXPECT_TERMINATOR, 200 + 40 * (_panels ? _panels : 1));
        if (n == 0) continue; // One missed reply must not abort discovery.
        const uint8_t *end = (const uint8_t*)memchr(cur, LB_TERMINATOR, n);
        if (!end) {
          n += receive(cur + n, sizeof(cur) - n, LB_EXPECT_TERMINATOR, LB_LONG_WINDOW_MS);
          end = (const uint8_t*)memchr(cur, LB_TERMINATOR, n);
          if (!end) continue;
        }
        n = end - cur + 1;
        leafbus::Panel parsed[leafbus::MAX_PANELS];
        if (leafbus::parseLayout(cur, n - 1, parsed, leafbus::MAX_PANELS) <= 0) continue;
        _layoutReplies++;
        stable = (n == lastLen && memcmp(cur, last, n) == 0);
        memcpy(last, cur, n);
        lastLen = n;
      }

      uint16_t panels = 0;
      for (size_t i = 0; stable && i + 1 < lastLen; i++) { // require matching valid replies
        uint8_t b = last[i];
        if ((b & 0x80) && ((b >> 4) & 7) != LB_PSU_CODE && panels < LB_MAX_PANELS) panels++;
      }
      if (panels != _panels) {
        DEBUG_PRINTF_P(PSTR("LeafBus: %u panel(s)%s\n"), panels, stable || !panels ? "" : " (layout unstable)");
      }
      if (stable && panels && (lastLen != _layoutLen || memcmp(last, _layout, lastLen) != 0)) {
        memcpy(_layout, last, lastLen);
        _layoutLen = lastLen;
        _mapDone = false;
      }
      _panels = panels;
      _hotplug = false;
      _missRun = 0;
      if (!_panels) return;

      send(fullBright, sizeof(fullBright)); // WLED scales brightness itself; undo any dimming left by the stock controller
      if (xSemaphoreTake(_lock, pdMS_TO_TICKS(20)) == pdTRUE) {
        _dirty = true; // show the current frame on the (re)found panels
        xSemaphoreGive(_lock);
      }
      _lastPoll = millis();
    }

    // Keep /ledmap.json in step with the physical layout, so WLED's 2D effects follow the wall: one
    // matrix cell per panel, placed with the LeafBus geometry, gaps elsewhere. A missing map or one
    // written here is replaced; a hand-made one is left alone.
    void updateLedmap() {
      _mapDone = true;
      if (!autoMap) return;
      leafbus::Panel panels[leafbus::MAX_PANELS];
      uint16_t cells[leafbus::MAX_PANELS];
      uint8_t width = 0, height = 0;
      int n = leafbus::parseLayout(_layout, _layoutLen - 1, panels, leafbus::MAX_PANELS);
      if (n <= 0 || !leafbus::placePanels(panels, n) || !leafbus::gridPanels(panels, n, rotation, width, height, cells)) {
        DEBUG_PRINTLN(F("LeafBus: layout not mappable to 2D"));
        return;
      }

      String json;
      json.reserve(128 + 2 * _layoutLen + 4U * width * height);
      json += F("{\"n\":\"Nanoleaf Shapes\",");
      json += LB_MAP_MARK;
      json += F(",\"rot\":");
      json += rotation;
      json += F(",\"layout\":\"");
      for (size_t i = 0; i < _layoutLen; i++) {
        char hex[3];
        snprintf_P(hex, sizeof(hex), PSTR("%02X"), _layout[i]);
        json += hex;
      }
      json += F("\",\"width\":");
      json += width;
      json += F(",\"height\":");
      json += height;
      json += F(",\"map\":["); // must stay the last key: WLED streams the numbers after it
      for (unsigned cell = 0; cell < (unsigned)width * height; cell++) {
        int led = -1;
        for (int i = 0; i < n; i++) if (cells[i] == cell) { led = i; break; }
        if (cell) json += ',';
        json += led;
      }
      json += F("]}");

      if (WLED_FS.exists(LB_LEDMAP)) {
        File f = WLED_FS.open(LB_LEDMAP, "r");
        String old = f ? f.readString() : String();
        f.close();
        if (old == json) return; // already matches this layout
        if (old.indexOf(LB_MAP_MARK) < 0) {
          DEBUG_PRINTLN(F("LeafBus: keeping the hand-made /ledmap.json"));
          return;
        }
      }
      File f = WLED_FS.open(LB_LEDMAP, "w");
      if (!f) return;
      f.print(json);
      f.close();

      strip.suspend();
      strip.waitForIt();
      strip.deserializeMap();       // picks up width and height as well
      strip.makeAutoSegments(true); // segments must span the new matrix
      strip.resume();
      DEBUG_PRINTF_P(PSTR("LeafBus: 2D map %ux%u for %d panels\n"), width, height, n);
    }

    void poll() {
      static const uint8_t pull[] = {LB_BULK_PULL};
      uint8_t reply[2 * LB_MAX_PANELS + 1];
      const size_t expect = 2 * _panels;

      _polls++;
      bool sent = send(pull, sizeof(pull));
      size_t n = sent ? receive(reply, sizeof(reply), expect, 40 + 20 * _panels) : 0;
      if (n == expect) n += receive(reply + n, 1, 1, 2); // a hot-plug marker follows the pairs
      _lastPoll = millis();

      if (n > 0 && reply[n - 1] == LB_HOTPLUG && (n - 1) % 2 == 0) {
        _hotplug = true; // re-enumerate: moved panels silently stop applying colour until we do
        return;
      }
      if (n < expect) {
        if (++_missRun >= LB_MISS_LIMIT) _panels = 0; // assembly gone or restarted: enumerate again
      } else {
        _missRun = 0;
        _pollReplies++;
      }
    }

    // Chunks run from the far end: chunk i drives the panel at layout position N-1-i.
    void push() {
      uint8_t frame[2 + 6 * LB_MAX_PANELS];
      size_t len = 0;
      if (xSemaphoreTake(_lock, pdMS_TO_TICKS(20)) != pdTRUE) return;
      const unsigned have = _framePixels;
      frame[len++] = LB_BULK_PUSH;
      frame[len++] = 0x03; // constant in every observed frame
      for (unsigned chunk = 0; chunk < _panels; chunk++) {
        unsigned pos = _panels - 1 - chunk;
        if (pos >= have) { // more panels than pixels captured: leave the rest unchanged
          frame[len++] = 0x01;
          frame[len++] = 0xFF;
          continue;
        }
        const uint8_t *p = _frame + pos * 4;
        frame[len++] = 0x05; // chunk length
        frame[len++] = LB_TRANSITION;
        frame[len++] = p[0];
        frame[len++] = p[1];
        frame[len++] = p[2];
        frame[len++] = p[3];
      }
      _dirty = false;
      xSemaphoreGive(_lock);
      if (send(frame, len)) _colourFrames++;
      _lastPush = millis();
    }
};

const char UsermodNanoleafShapes::_name[] PROGMEM = "NanoleafShapes";

static UsermodNanoleafShapes nanoleaf_shapes;
REGISTER_USERMOD(nanoleaf_shapes);
// AI: end
#endif
